VERSION "1.0.0"

NS_ :

BS_ :

BU_ : XXX X

BO_ 209 vehicle_speed: 8 XXX
 SG_ vehicle_speed : 0|16@1+ (0.05625,0) [0|0] "kph" XXX
